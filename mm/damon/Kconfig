## mm/damon/Kconfig
```kconfig
# SPDX-License-Identifier: GPL-2.0
menu "Data Access Monitoring"
config DAMON
	bool "DAMON: Data Access Monitoring Framework"
	default y
	help
	  Builds the DAMON data access monitoring framework. Address-space
	  specific monitoring primitives are enabled by separate options.
config DAMON_VADDR
	bool "DAMON virtual address monitoring"
	depends on DAMON && MMU
	select PAGE_IDLE_FLAG
	help
	  Enables the virtual-address-space monitoring primitive.
config DAMON_DBGFS
	bool "DAMON debugfs interface"
	depends on DAMON_VADDR && DEBUG_FS
endmenu
```
